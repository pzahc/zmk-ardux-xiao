#include <behaviors.dtsi>
#include <dt-bindings/zmk/keys.h>
#include <dt-bindings/zmk/bt.h>

// Left-handed ARDUX
#define ARDUX_LEFT 1

// ARTS Row (mirrored for left hand)
#define KEY_A 3
#define KEY_R 2
#define KEY_T 1
#define KEY_S 0
// EYIO Row (mirrored for left hand)
#define KEY_E 7
#define KEY_Y 6
#define KEY_I 5
#define KEY_O 4

// Define Offsets (none needed for a plain 8-key board)
#define LEADING_NONES NONE(0,0,0)
#define MIDDLE_NONES NONE(0,0,0)
#define TRAILING_NONES NONE(0,0,0)

// Include the full ARDUX layout
#include "../../../ardux.dtsi"
