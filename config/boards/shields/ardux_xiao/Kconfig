## config/boards/shields/ardux_xiao/Kconfig
```kconfig
config ARDUX_XIAO_PER_KEY_LED
	bool "Per-key LED support for ARDUX XIAO"
	default y
	depends on WS2812_STRIP
```

## config/boards/shields/ardux_xiao/Kconfig.defconfig
```kconfig
if SHIELD_ARDUX_XIAO_LEFT || SHIELD_ARDUX_XIAO_RIGHT

config ZMK_KEYBOARD_NAME
	default "ARDUX XIAO"

config ARDUX_XIAO_PER_KEY_LED
	bool "Per-key LED support for ARDUX XIAO"
	default y
	depends on WS2812_STRIP

endif
```

## config/boards/shields/ardux_xiao/Kconfig.shield
```kconfig
config SHIELD_ARDUX_XIAO_LEFT
	def_bool $(shields_list_contains,ardux_xiao_left)

config SHIELD_ARDUX_XIAO_RIGHT
	def_bool $(shields_list_contains,ardux_xiao_right)
```
